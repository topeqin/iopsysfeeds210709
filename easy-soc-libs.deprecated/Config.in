## easy-soc-libs.deprecated/Config.in
```kconfig
if (PACKAGE_libwifix)
menu "configurations"

config LIBWIFIX_DEBUG
	depends on PACKAGE_libwifix
	bool "Enable wifi debugging"
	default n

endmenu
endif
```

## easy-soc-libs/Config.in
```kconfig
# libeasy configuration

config LIBWIFI_USE_CTRL_IFACE
	bool "Use UNIX sockets"
	default n
```

## icwmp/Config.in
```kconfig
if PACKAGE_icwmp-curl || PACKAGE_icwmp-zstream

config CWMP_SCRIPTS_FULL
	bool "Install all icwmp scripts"
	default y

choice
	prompt "Select ACS sever"
	default CWMP_ACS_MULTI

config CWMP_ACS_MULTI
	bool "No specific ACS, follow standard"

config CWMP_ACS_HDM
	bool "HDM"
endchoice

choice
	prompt "Select Data Model"
	default tr098

config DATAMODEL_TR098
	bool "TR-098"

config DATAMODEL_TR181
	bool "TR-181"
endchoice

config CWMP_DEBUG
	bool "Compile with debug options"
	default y

choice
	prompt "enable xmpp feature"
	default disable

config XMPP_DISABLE
	bool "disable"

config XMPP_ENABLE
	bool "enable"
endchoice
config CWMP_DEVEL_DEBUG
	bool "Compile with development debug options"
	default n

endif
```

## ieee1905-meshcomm/Config.in
```kconfig
if PACKAGE_ieee1905-meshcomm || PACKAGE_lib1905al

menu "developer/debug options"

	config IEEE1905_MAP_COMPLETE_NETWORK
		bool "Create network topology for complete network"
		default n

	config IEEE1905_SPEED_UP_DISCOVERY
		bool "Speed up discovery of an AL in network"
		default y

	config IEEE1905_DO_NOT_ACCEPT_UNAUTHENTICATED_COMMANDS
		bool "Do not accept M1/M2 messages from unknown AL(s)"
		default y

	choice
		prompt "Select ALME support"
		default IEEE1905_ALME_OVER_UBUS

		config IEEE1905_ALME_OVER_UBUS
			bool "ALME methods supported over ubus"

		#config IEEE1905_ALME_OVER_TCP
		#	bool "ALME server over TCP port"

	endchoice
endmenu
endif
```

## ieee1905/Config.in
```kconfig
if (PACKAGE_ieee1905)

menu "Configurations"

config IEEE1905_EXTENSION_ALLOWED
	bool "Allow plugins to extend 1905 CMDUs and/or TLVs"
	default y

endmenu
endif
```

## iop-lla-libs/Config.in
```kconfig
if (PACKAGE_libwifi || PACKAGE_libdsl || PACKAGE_libethernet)
menu "configurations"

config IOP_LLA_LIBS_DEBUG
	bool "Enable debugging support"
	default n

config LIBWIFI_DEBUG
	depends on PACKAGE_libwifi
	bool "Enable wifi debugging"
	default n

config LIBDSL_DEBUG
	depends on PACKAGE_libdsl
	bool "Enable xdsl debugging"
	default n

endmenu
endif
```

## natalie-dect/Config.in
```kconfig
config NATALIE_OPEN
       bool "Use pre-compiled version for Open SDK"
       default n
```

## obuspa/Config.in
```kconfig
if PACKAGE_obuspa

config OBUSPA_MTP_ENABLE_STOMP
	bool "Enable STOMP as mtp protocol"
	default y

config OBUSPA_MTP_ENABLE_MQTT
	bool "Enable MQTT as mtp protocol"
	default y

config OBUSPA_MTP_ENABLE_COAP
	bool "Enable CoAP as mtp protocol"
	default y

endif
```

## owsd/Config.in
```kconfig
choice
	prompt "Select IPC Bus"
	default OWSD_USE_UBUS
	depends on PACKAGE_owsd
	help
		Select which IPC bus to compile owsd for

config OWSD_USE_DBUS
	bool "Use DBUS"

config OWSD_USE_UBUS
	bool "Use UBUS"

config OWSD_USE_DBUS_UBUS
	bool "Use UBUS and DBUS"

endchoice

config OWSD_UPROXYD
	bool "Enable UBUS Proxy Daemon"
	default y if OWSD_USE_UBUS || OWSD_USE_DBUS_UBUS
        help
          Enabling uproxyd automates detection of other
	  UBUS-X enabled devices in the network
```

## tr098/Config.in
```kconfig
if PACKAGE_libtr098

config LIBTR098_VENDOR_PREFIX
    string "TR-098 Vendor Prefix"
    default "X_IOPSYS_EU_"

config UPNP_TR064
	bool "Compile with tr064 features"
	default n
	
endif
```

## wfadatad/Config.in
```kconfig
if (PACKAGE_wfadatad)
menu "configurations"

config WFA_DELM_STANDALONE
	bool "Build as standalone daemon instead of a plugin"
	default y

config WFA_DELM_MULTIAP_MODE
	bool "Enable Multi-AP mode"
	default y

config WIFI_DELM_DEBUG
	bool "Enable debug logs"
	default n
endmenu
endif
```

## wifilife/Config.in
```kconfig
config WIFILIFE_OPEN
       bool "Use pre-compiled version for Open SDK"
       default n
```
